## arch/arm/mach-msm/lge/Kconfig.board
```kconfig
#
# Inlcude the specific Kconfig file for LGE board
#

# J1V
source "arch/arm/mach-msm/lge/j1/Kconfig"

config MACH_LGE_DUMMY
	bool "NONE (No device)"
```
